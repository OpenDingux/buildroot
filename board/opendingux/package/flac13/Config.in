## board/opendingux/package/flac13/Config.in
```kconfig
config BR2_PACKAGE_FLAC13
	bool "flac13"
	depends on BR2_USE_WCHAR
	help
	  FLAC is an Open Source lossless audio codec.

	  http://flac.sourceforge.net/

comment "flac13 needs a toolchain w/ wchar"
	depends on !BR2_USE_WCHAR
```
